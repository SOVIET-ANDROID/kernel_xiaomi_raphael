/* Copyright (c) 2020, The Linux Foundation. All rights reserved.
 *
 * This program is free software; you can redistribute it and/or modify
 * it under the terms of the GNU General Public License version 2 and
 * only version 2 as published by the Free Software Foundation.
 *
 * This program is distributed in the hope that it will be useful,
 * but WITHOUT ANY WARRANTY; without even the implied warranty of
 * MERCHANTABILITY or FITNESS FOR A PARTICULAR PURPOSE.  See the
 * GNU General Public License for more details.
 */

/dts-v1/;

#include "qcs405.dtsi"
#include "sa2150p-ccard.dtsi"
#include "sa2145p-ccard.dtsi"

/ {
	model = "Qualcomm Technologies, Inc. SA2150P CCARD NAND eMMC";
	compatible = "qcom,sa2150p-ccard", "qcom,qcs405", "qcom,sa2150p",
				"qcom,ccard";
	qcom,board-id = <0x010119 3>;
};

&sdhc_2 {
	/delete-property/ cd-gpios;
	qcom,nonhotplug;
	qcom,nonremovable;

	qcom,vdd-io-always-on;
	qcom,vdd-io-lpm-sup;
	qcom,vdd-io-voltage-level = <1800000 1800000>;
	qcom,vdd-io-current-level = <0 325000>;

	qcom,bus-speed-mode = "HS400_1p8v", "HS200_1p8v", "DDR_1p8v";

	pinctrl-0 = <&sdc2_clk_on  &sdc2_cmd_on &sdc2_data_on>;
	pinctrl-1 = <&sdc2_clk_off &sdc2_cmd_off &sdc2_data_off>;
};

&i2c_3 {
	status = "okay";

	eeprom@57 {
		compatible = "atmel,24c128";
		reg = <0x57>;
		pagesize = <32>;
	};
};
