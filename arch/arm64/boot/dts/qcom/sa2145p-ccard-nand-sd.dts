/* Copyright (c) 2020, The Linux Foundation. All rights reserved.
 *
 * This program is free software; you can redistribute it and/or modify
 * it under the terms of the GNU General Public License version 2 and
 * only version 2 as published by the Free Software Foundation.
 *
 * This program is distributed in the hope that it will be useful,
 * but WITHOUT ANY WARRANTY; without even the implied warranty of
 * MERCHANTABILITY or FITNESS FOR A PARTICULAR PURPOSE.  See the
 * GNU General Public License for more details.
 */

/dts-v1/;

#include "qcs403.dtsi"
#include "sa2150p-ccard.dtsi"
#include "sa2145p-ccard.dtsi"

/ {
	model = "Qualcomm Technologies, Inc. SA2145P CCARD NAND SD";
	compatible = "qcom,sa2145p-ccard", "qcom,qcs403", "qcom,sa2145p",
				"qcom,ccard";
	qcom,board-id = <0x010019 3>;
};

&i2c_3 {
	status = "okay";

	eeprom@57 {
		compatible = "atmel,24c128";
		reg = <0x57>;
		pagesize = <32>;
	};
};
